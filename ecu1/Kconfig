## ecu1/Kconfig
```kconfig
menuconfig DRIVERS_ECU1
	bool "ecu1"
	default n
	---help---
		Enable support for ecu1
```

## ecu2/Kconfig
```kconfig
menuconfig DRIVERS_ECU2
	bool "ecu2"
	default n
	---help---
		Enable support for ecu2
```
